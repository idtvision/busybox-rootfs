## configs/enclustra_xilinx_zynqmp_defconfig
```kconfig
BR2_aarch64=y
BR2_BACKUP_SITE="http://www.enclustra.com/binaries/enclustra-bsp/busybox-rootfs"
BR2_TOOLCHAIN_BUILDROOT_GLIBC=y
BR2_KERNEL_HEADERS_4_9=y
BR2_TARGET_GENERIC_ROOT_PASSWD="root"
BR2_TARGET_GENERIC_GETTY_PORT="ttyPS0"
BR2_ROOTFS_POST_BUILD_SCRIPT="board/enclustra/ebe_overlays.sh"
BR2_PACKAGE_BUSYBOX_SHOW_OTHERS=y
BR2_PACKAGE_GDB=y
BR2_PACKAGE_GDB_SERVER=y
BR2_PACKAGE_GDB_DEBUGGER=y
BR2_PACKAGE_TCF_AGENT=y
BR2_PACKAGE_DOSFSTOOLS=y
BR2_PACKAGE_DOSFSTOOLS_FATLABEL=y
BR2_PACKAGE_DOSFSTOOLS_FSCK_FAT=y
BR2_PACKAGE_DOSFSTOOLS_MKFS_FAT=y
BR2_PACKAGE_E2TOOLS=y
BR2_PACKAGE_MMC_UTILS=y
BR2_PACKAGE_MTD=y
BR2_PACKAGE_MTD_TESTS=y
BR2_USE_MMU=y
BR2_TOOLCHAIN_HAS_THREADS=y
BR2_PACKAGE_MEMTESTER=y
BR2_PACKAGE_DHCPCD=y
BR2_PACKAGE_IPERF3=y
BR2_PACKAGE_OPENSSH=y
BR2_TARGET_ROOTFS_CPIO=y
BR2_TARGET_ROOTFS_CPIO_GZIP=y
BR2_TARGET_ROOTFS_CPIO_UIMAGE=y
BR2_TARGET_ROOTFS_JFFS2=y
BR2_TARGET_ROOTFS_JFFS2_CUSTOM=y
BR2_TARGET_ROOTFS_JFFS2_NOCLEANMARKER=y
BR2_TARGET_ROOTFS_UBIFS=y
BR2_TARGET_ROOTFS_UBIFS_LEBSIZE=0x1f000
BR2_TARGET_ROOTFS_UBIFS_MAXLEBCNT=4096
BR2_TARGET_ROOTFS_UBI=y
BR2_TARGET_ROOTFS_UBI_SUBSIZE=2048
BR2_TOOLCHAIN_BUILDROOT_CXX=y
BR2_INSTALL_LIBSTDCPP=y
#BR2_PACKAGE_BZIP2=y
#BR2_PACKAGE_BOOST=y
#BR2_PACKAGE_BOOST_LAYOUT_SYSTEM=y
#BR2_PACKAGE_BOOST_LAYOUT="system"
#BR2_PACKAGE_BOOST_ATOMIC=y
#BR2_PACKAGE_BOOST_CHRONO=y
#BR2_PACKAGE_BOOST_CONTAINER=y
#BR2_PACKAGE_BOOST_DATE_TIME=y
#BR2_PACKAGE_BOOST_EXCEPTION=y
#BR2_PACKAGE_BOOST_FIBER=y
#BR2_PACKAGE_BOOST_FILESYSTEM=y
#BR2_PACKAGE_BOOST_GRAPH=y
#BR2_PACKAGE_BOOST_GRAPH_PARALLEL=y
#BR2_PACKAGE_BOOST_IOSTREAMS=y
#BR2_PACKAGE_BOOST_LOCALE=y
#BR2_PACKAGE_BOOST_LOG=y
#BR2_PACKAGE_BOOST_MATH=y
#BR2_PACKAGE_BOOST_MPI=y
#BR2_PACKAGE_BOOST_PROGRAM_OPTIONS=y
#BR2_PACKAGE_BOOST_RANDOM=y
#BR2_PACKAGE_BOOST_REGEX=y
#BR2_PACKAGE_BOOST_SERIALIZATION=y
#BR2_PACKAGE_BOOST_SIGNALS=y
#BR2_PACKAGE_BOOST_STACKTRACE=y
#BR2_PACKAGE_BOOST_SYSTEM=y
#BR2_PACKAGE_BOOST_TEST=y
#BR2_PACKAGE_BOOST_THREAD=y
#BR2_PACKAGE_BOOST_TIMER=y
#BR2_PACKAGE_BOOST_TYPE_ERASURE=y
#BR2_PACKAGE_BOOST_WAVE=y
```
